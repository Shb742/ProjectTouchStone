## Firmware/main/Kconfig.projbuild
```kconfig
menu "Project Touch Stone"

menu "Wifi Configuration"

config WIFI_SSID
    string "WiFi SSID"
    default "myssid"
    help
        SSID (network name) to connect to.

config WIFI_PASSWORD
    string "WiFi Password"
    default "myssid"
    help
        WiFi password (WPA or WPA2) to use.

        Can be left blank if the network has no security set.

endmenu

menu "Audio Output"

choice
    prompt "Select Audio Output Mode"
    default I2S
    help
        This option selects the audio output.

    config AUDIO_OUTPUT_MODE_I2S
        bool "Generic I2S"
    config AUDIO_OUTPUT_MODE_I2S_MERUS
        bool "Merus Audio I2S"
endchoice

config AUDIO_OUTPUT_MODE
    int
    default 0 if AUDIO_OUTPUT_MODE_I2S
    default 1 if AUDIO_OUTPUT_MODE_I2S_MERUS
endmenu

menu "API ENDPOINT"
config TS_HOST
    string "TS_HOST"
    default "ts.mntco.de"
    help
        url of the server

config TS_PORT
    string "TS_PORT"
    default "443"
    help
        port of the server
endmenu

endmenu
```
